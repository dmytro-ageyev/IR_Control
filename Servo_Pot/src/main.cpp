/**
 * @file Servo_Pot.ino
 * @brief Керування сервоприводом за допомогою потенціометра з візуальним інтерфейсом у Serial Monitor.
 *
 * Ця програма зчитує аналоговий сигнал з потенціометра, підключеного до входу A0, 
 * перетворює його у значення кута в діапазоні 0–180° і повертає сервопривід 
 * у відповідне положення. Вивід у монітор порту здійснюється лише при зміні кута 
 * більш ніж на 5°, що дозволяє уникнути надмірного оновлення екрана.
 *
 * Для користувача виводиться "графічний" індикатор поточного кута у вигляді шкали,
 * що дозволяє візуально оцінити положення сервоприводу.
 *
 * --- Підключення ---
 *  Потенціометр:
 *    - Лівий контакт  → GND
 *    - Центральний контакт → A0
 *    - Правий контакт → 5V
 *
 *  Сервопривід:
 *    - Помаранчевий (сигнал) → D11
 *    - Червоний (живлення) → 5V
 *    - Коричневий (земля) → GND
 *
 * --- Необхідні бібліотеки ---
 *  - Servo.h  (входить до стандартної бібліотеки Arduino IDE)
 *
 * --- Автор ---
 *  @author  Дмитро Агеєв
 *  @date    08.10.2025
 *  @license MIT
 */

#include <Arduino.h>  // Основна бібліотека Arduino
#include <Servo.h>    // Клас для роботи з сервоприводами

// ----------------------------------------------------------
//               Глобальні константи та змінні
// ----------------------------------------------------------

/**
 * @brief Пін, до якого підключено потенціометр.
 */
const int POT_PIN = A0;

/**
 * @brief Пін керування сервоприводом.
 */
const int SERVO_PIN = 11;

/**
 * @brief Межі руху сервоприводу (у градусах).
 */
const int MIN_ANGLE = 0;
const int MAX_ANGLE = 180;

/**
 * @brief Мінімальна зміна кута, за якої оновлюється вивід у монітор.
 */
const int ANGLE_TOLERANCE = 5;

/**
 * @brief Мінімальна зміна кута, за якої оновлюється вивід у монітор.
 */
const int MAX_SEGMENT = (MAX_ANGLE - MIN_ANGLE) / ANGLE_TOLERANCE;

Servo myServo;        ///< Об’єкт сервоприводу
int lastAngle = -1;   ///< Збережений попередній кут для перевірки змін

// ----------------------------------------------------------
//                   ІНІЦІАЛІЗАЦІЯ
// ----------------------------------------------------------

/**
 * @brief Ініціалізація Serial Monitor та серво.
 *
 * Встановлює швидкість передачі даних 9600 бод,
 * приєднує сервопривід до вказаного піна
 * та виводить коротку інформацію для користувача.
 */
void setup() {
  Serial.begin(9600);
  myServo.attach(SERVO_PIN);

  Serial.println("====================================================");
  Serial.println(" 🧭  Система керування сервоприводом потенціометром ");
  Serial.println("====================================================");
  Serial.println("Поверніть ручку потенціометра, щоб змінити кут сервоприводу.");
  Serial.println("Дані оновлюються лише при зміні кута більше ніж на 5°.\n");
  delay(1000);
}

// ----------------------------------------------------------
//                ДОПОМІЖНА ФУНКЦІЯ ВИВОДУ
// ----------------------------------------------------------

/**
 * @brief Виводить поточний кут сервоприводу у Serial Monitor у графічному вигляді.
 *
 * Ця функція створює шкалу з MAX_SEGMENT сегментів, яка показує поточне положення
 * сервоприводу. Кількість заповнених сегментів відповідає куту повороту.
 *
 * @param angle Поточний кут сервоприводу (0–180°).
 */
void PrintAngleChange(int angle) {
  // Оновлення лише при значній зміні
  if (abs(angle - lastAngle) >= ANGLE_TOLERANCE) {
        lastAngle = angle;        // Оновлення попереднього значення
        Serial.print("Кут: ");
        Serial.print(angle);
        Serial.print("° \t[");

  // Розрахунок кількості заповнених сегментів
        int filled = map(angle, MIN_ANGLE, MAX_ANGLE, 0, MAX_SEGMENT);
        for (int i = 0; i < MAX_SEGMENT; i++) {
          if (i < filled) Serial.print("#");
          else Serial.print("-");
        }

        Serial.println("]");
      }
}

// ----------------------------------------------------------
//                     ОСНОВНИЙ ЦИКЛ
// ----------------------------------------------------------

/**
 * @brief Основний цикл програми.
 *
 * У кожній ітерації програма зчитує поточне значення потенціометра,
 * перетворює його у кут сервоприводу, і якщо зміна перевищує поріг,
 * оновлює положення серво та вивід у монітор порту.
 */
void loop() {
  // Зчитування аналогового сигналу з потенціометра
  int potValue = analogRead(POT_PIN);

  // Перетворення сигналу в кут сервоприводу
  int angle = map(potValue, 0, 1023, MIN_ANGLE, MAX_ANGLE);

  myServo.write(angle);     // Встановлення нового кута
  PrintAngleChange(angle);  // Вивід у монітор порту

  delay(50); // Невелика пауза для стабільності
}
